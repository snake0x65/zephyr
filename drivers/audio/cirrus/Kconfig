## drivers/audio/cirrus/Kconfig
```kconfig
# Copyright 2026 Cirrus Logic, Inc. and
#                  Cirrus Logic International Semiconductor Ltd.
#
# SPDX-License-Identifier: Apache-2.0

menu "Cirrus Logic audio drivers"


config AUDIO_CIRRUS
	bool "Cirrus Logic audio driver support"
	default y

if AUDIO_CIRRUS

source "drivers/audio/cirrus/common/Kconfig"
source "drivers/audio/cirrus/cs35l41/Kconfig"

endif

module = AUDIO_CIRRUS
module-str = cirrus
source "subsys/logging/Kconfig.template.log_config"

config CIRRUS_INIT_PRIORITY
	int "Audio driver init priority"
	default 90
	help
	 Audio driver initialization priority.


endmenu
```

## drivers/audio/cirrus/common/Kconfig
```kconfig
#
# Copyright 2026 Cirrus Logic, Inc. and
#                  Cirrus Logic International Semiconductor Ltd.
#
# SPDX-License-Identifier: Apache-2.0

config AUDIO_CIRRUS_I2C
	bool
	default y if I2C
	depends on I2C

config AUDIO_CIRRUS_SPI
	bool
	default y if SPI
	depends on SPI
```

## drivers/audio/cirrus/cs35l41/Kconfig
```kconfig
# Copyright 2026 Cirrus Logic, Inc. and
#                  Cirrus Logic International Semiconductor Ltd.
#
# SPDX-License-Identifier: Apache-2.0

config AUDIO_CS35L41
	bool "Cirrus CS35L41 amplifier driver"
	default n
	help
	  Cirrus CS35L41 amplifier driver core.

config AUDIO_CS35L41_SPI
	bool "Cirrus CS35L41 amplifier driver SPI"
	depends on AUDIO_CS35L41 && SPI
	default y if $(dt_compat_on_bus,$(DT_COMPAT_CIRRUS_CS35L41_SPI),spi)
	help
	  Cirrus CS35L41 amplifier driver SPI.

config AUDIO_CS35L41_I2C
	bool "Cirrus CS35L41 amplifier driver over I2C"
	depends on AUDIO_CS35L41 && I2C
	default y if $(dt_compat_on_bus,$(DT_COMPAT_CIRRUS_CS35L41_I2C),i2c)
	help
	  Cirrus CS35L41 amplifier driver I2C.
```

## dts/bindings/audio/cirrus,cs35l41-i2c.yaml
```yaml
description: Cirrus Logic CS4XA09 audio codec over I2C

compatible: "cirrus,cs35l41-i2c"

include: ["i2c-device.yaml", "cirrus,cs35l41.yaml"]

properties:
  reg:
    required: true
```

## dts/bindings/audio/cirrus,cs35l41-spi.yaml
```yaml
description: Cirrus Logic CS4XA09 audio codec over SPI

compatible: "cirrus,cs35l41-spi"

include: ["spi-device.yaml", "cirrus,cs35l41.yaml"]

properties:
  reg:
    required: true

  spi-max-frequency:
    type: int
    required: true
```
